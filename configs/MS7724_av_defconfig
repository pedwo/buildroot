## configs/ap325rxa_defconfig
```kconfig
BR2_sh=y
BR2_WGET="wget --passive-ftp --no-check-certificate -nd -t 3"
BR2_TOOLCHAIN_EXTERNAL=y
BR2_TOOLCHAIN_EXTERNAL_CUSTOM=y
BR2_TOOLCHAIN_EXTERNAL_PATH="/usr/share/renesas-4.4"
BR2_TOOLCHAIN_EXTERNAL_CUSTOM_PREFIX="sh-linux-gnu"
BR2_TOOLCHAIN_EXTERNAL_CUSTOM_GLIBC=y
BR2_TOOLCHAIN_EXTERNAL_CXX=y
BR2_TARGET_GENERIC_GETTY=y
BR2_TARGET_GENERIC_GETTY_PORT="ttySC5"
BR2_TARGET_GENERIC_GETTY_BAUDRATE_38400=y
BR2_ROOTFS_SKELETON_CUSTOM=y
BR2_ROOTFS_SKELETON_CUSTOM_PATH="board/renesas/skeleton"
BR2_TARGET_ROOTFS_EXT2=y
# BR2_TARGET_ROOTFS_TAR is not set
BR2_TARGET_UBOOT=y
BR2_TARGET_UBOOT_BOARDNAME="ap325rxa"
BR2_TARGET_UBOOT_2010_03=y
# BR2_TARGET_UBOOT_NETWORK is not set
BR2_LINUX_KERNEL=y
BR2_LINUX_KERNEL_CUSTOM_VERSION=y
BR2_LINUX_KERNEL_CUSTOM_VERSION_VALUE="2.6.35.12"
BR2_LINUX_KERNEL_PATCH="board/renesas/ap325rxa/kernel-patches"
BR2_LINUX_KERNEL_USE_CUSTOM_CONFIG=y
BR2_LINUX_KERNEL_CUSTOM_CONFIG_FILE="board/renesas/ap325rxa/linux-$(BR2_LINUX_KERNEL_VERSION).config"
```

## configs/ap4evb_defconfig
```kconfig
BR2_arm=y
BR2_cortex_a8=y
BR2_WGET="wget --passive-ftp --no-check-certificate -nd -t 3"
BR2_TOOLCHAIN_EXTERNAL=y
BR2_TOOLCHAIN_EXTERNAL_CUSTOM=y
BR2_TOOLCHAIN_EXTERNAL_PATH="/usr/share/arm-2010.09"
BR2_TOOLCHAIN_EXTERNAL_CUSTOM_PREFIX="arm-none-linux-gnueabi"
BR2_TOOLCHAIN_EXTERNAL_CUSTOM_GLIBC=y
BR2_TOOLCHAIN_EXTERNAL_CXX=y
BR2_TARGET_GENERIC_GETTY=y
BR2_TARGET_GENERIC_GETTY_PORT="ttySC0"
BR2_ROOTFS_SKELETON_CUSTOM=y
BR2_ROOTFS_SKELETON_CUSTOM_PATH="board/renesas/skeleton"
BR2_TARGET_ROOTFS_EXT2=y
# BR2_TARGET_ROOTFS_TAR is not set
BR2_LINUX_KERNEL=y
# BR2_LINUX_KERNEL_2_6_37 is not set
BR2_LINUX_KERNEL_CUSTOM_VERSION=y
# BR2_LINUX_KERNEL_CUSTOM_TARBALL is not set
BR2_LINUX_KERNEL_CUSTOM_VERSION_VALUE="2.6.38"
BR2_LINUX_KERNEL_VERSION="2.6.38"
BR2_LINUX_KERNEL_PATCH="board/renesas/ap4evb/kernel-patches"
# BR2_LINUX_KERNEL_USE_DEFCONFIG is not set
BR2_LINUX_KERNEL_USE_CUSTOM_CONFIG=y
BR2_LINUX_KERNEL_CUSTOM_CONFIG_FILE="board/renesas/ap4evb/linux-$(BR2_LINUX_KERNEL_VERSION).config"
```

## configs/sh7785lcr_defconfig
```kconfig
BR2_sh=y
BR2_WGET="wget --passive-ftp --no-check-certificate -nd -t 3"
BR2_TOOLCHAIN_EXTERNAL=y
BR2_TOOLCHAIN_EXTERNAL_CUSTOM=y
BR2_TOOLCHAIN_EXTERNAL_PATH="/usr/share/renesas-4.4"
BR2_TOOLCHAIN_EXTERNAL_CUSTOM_PREFIX="sh-linux-gnu"
BR2_TOOLCHAIN_EXTERNAL_CUSTOM_GLIBC=y
BR2_TOOLCHAIN_EXTERNAL_CXX=y
BR2_TARGET_GENERIC_GETTY=y
BR2_TARGET_GENERIC_GETTY_PORT="ttySC1"
BR2_ROOTFS_SKELETON_CUSTOM=y
BR2_ROOTFS_SKELETON_CUSTOM_PATH="board/renesas/skeleton"
BR2_TARGET_ROOTFS_EXT2=y
# BR2_TARGET_ROOTFS_TAR is not set
BR2_LINUX_KERNEL=y
BR2_LINUX_KERNEL_CUSTOM_VERSION=y
BR2_LINUX_KERNEL_CUSTOM_VERSION_VALUE="2.6.35.12"
BR2_LINUX_KERNEL_PATCH="board/renesas/sh7785lcr/kernel-patches"
BR2_LINUX_KERNEL_USE_CUSTOM_CONFIG=y
BR2_LINUX_KERNEL_CUSTOM_CONFIG_FILE="board/renesas/sh7785lcr/linux-$(BR2_LINUX_KERNEL_VERSION).config"
```

## package/directfb-sh772x-gfx/Config.in
```kconfig
config BR2_PACKAGE_DIRECTFB_SH772X_GFX
	bool "SH772x Graphics kernel module for DirectFB"
	select BR2_PACKAGE_DIRECTFB
	help
	  SH772x (SH-Mobile R series) Graphics kernel module for DirectFB.
	  This allows DirectFB to use the Blend Engine Unit hardware to
	  perform blending, and the 2DG hardware for graphics.
```

## package/gst-sh-mobile/Config.in
```kconfig
config BR2_PACKAGE_GST_SH_MOBILE
	bool "gst-sh-mobile"
	depends on BR2_PACKAGE_GSTREAMER
	select BR2_PACKAGE_GST_PLUGINS_BASE
	select BR2_PACKAGE_UIOMUX
	select BR2_PACKAGE_SHVEU
	select BR2_PACKAGE_SHCODECS
	help
	  Renesas SH GStreamer plugins for accelerated video encoding and
	  decoding.

	  http://github.com/pedwo/gst-sh-mobile/
```

## package/gst-shrtsp/Config.in
```kconfig
config BR2_PACKAGE_GST_SHRTSP
	bool "gst-shrtsp"
	select BR2_PACKAGE_GST_RTSP
	select BR2_PACKAGE_GST_SH_MOBILE
	help
	  Renesas SH GStreamer Real Time Streaming Protocol (RTSP) server.

	  http://github.com/pedwo/gst-shrtsp/
```

## package/multimedia-demo/Config.in
```kconfig
config BR2_PACKAGE_REN_MM_DEMO
	bool "Renesas MS7724 multimedia demo launcher"
	depends on BR2_PACKAGE_QT
	help
	  A Qt app providing a simple way to run MS7724 multimedia demos.
```

## package/multimedia/faac/Config.in
```kconfig
config BR2_PACKAGE_FAAC
	bool "faac"
	help
	  FAAC is an MPEG-4 and MPEG-2 AAC encoder.
```

## package/multimedia/faad/Config.in
```kconfig
config BR2_PACKAGE_FAAD
	bool "faad"
	help
	  FAAD2 is an open source MPEG-4 and MPEG-2 AAC decoder.
```

## package/multimedia/gst-ffmpeg/Config.in
```kconfig
config BR2_PACKAGE_GST_FFMPEG
	bool "gst-ffmpeg"
	depends on BR2_PACKAGE_GSTREAMER
	select BR2_PACKAGE_GST_PLUGINS_BASE
	help
	  GStreamer FFmpeg plug-in contains one plugin with a set of elements
	  using the FFmpeg library code. It contains most popular decoders as
	  well as very fast colorspace conversion elements.

	  http://gstreamer.freedesktop.org/
```

## package/multimedia/gst-openmax/Config.in
```kconfig
config BR2_PACKAGE_GST_OPENMAX
	bool "gst-openmax"
	depends on BR2_PACKAGE_GSTREAMER
	select BR2_PACKAGE_GST_PLUGINS_BASE
	help
	  GStreamer wrapper for OpenMAX IL components.

	  http://www.freedesktop.org/wiki/GstOpenMAX
```

## package/multimedia/gst-rtsp/Config.in
```kconfig
config BR2_PACKAGE_GST_RTSP
	bool "gst-rtsp"
	depends on BR2_PACKAGE_GSTREAMER
	select BR2_PACKAGE_GST_PLUGINS_BASE
	help
	  A GStreamer based RTSP server.

	  http://gstreamer.freedesktop.org/modules/gst-rtsp-server.html
```

## package/multimedia/omxil-bellagio/Config.in
```kconfig
config BR2_PACKAGE_OMXIL_BELLAGIO
	bool "omxil-bellagio"
	help
	  Bellagio is an opensource implementation of the OpenMAX IL API.

	  http://omxil.sourceforge.net/index.html
```

## package/omxil-sh/Config.in
```kconfig
config BR2_PACKAGE_OMXIL_SH
	bool "omxil-sh"
	select BR2_PACKAGE_UIOMUX
	select BR2_PACKAGE_SHCODECS if BR2_sh

	select BR2_PACKAGE_OMXIL_BELLAGIO
	help
	  libshveu: A collection of OpenMAX IL components for SH-Mobile.

	  http://github.com/pedwo/omxil-sh/
```

## package/shbeu/Config.in
```kconfig
config BR2_PACKAGE_SHBEU
	bool "shbeu"
	select BR2_PACKAGE_UIOMUX
	help
	  libshbeu: A library for controlling the SH-Mobile BEU.

	  http://github.com/pedwo/libshbeu/
```

## package/shcodecs/Config.in
```kconfig
config BR2_PACKAGE_SHCODECS
	bool "shcodecs"
	select BR2_PACKAGE_UIOMUX
	select BR2_PACKAGE_SHVEU
	select BR2_PACKAGE_SHBEU
	help
	  libshcodecs: A library for controlling SH-Mobile hardware codecs.

	  http://github.com/pedwo/libshcodecs/
```

## package/shjpeg/Config.in
```kconfig
config BR2_PACKAGE_SHJPEG
	bool "shjpeg"
	select BR2_PACKAGE_UIOMUX
	select BR2_PACKAGE_JPEG
	help
	  libshjpeg: A library for controlling the SH-Mobile JPEG Processing Unit (JPU).

	  http://github.com/pedwo/libshjpeg/
```

## package/shveu/Config.in
```kconfig
config BR2_PACKAGE_SHVEU
	bool "shveu"
	select BR2_PACKAGE_UIOMUX
	help
	  libshveu: A library for controlling the SH-Mobile VEU.

	  http://github.com/pedwo/libshveu/
```

## package/sighttpd/Config.in
```kconfig
config BR2_PACKAGE_SIGHTTPD
	bool "sighttpd"
	help
	  Sighttpd is an HTTP streaming server designed for distributing
	  realtime input. It is particularly useful for making camera streams
	  available to multiple clients, and has been designed for embedded
	  systems use.

	  http://www.kfish.org/software/sighttpd
	  http://github.com/kfish/sighttpd
```

## package/uiomux/Config.in
```kconfig
config BR2_PACKAGE_UIOMUX
	bool "uiomux"
	help
	  UIOMux is a conflict manager for system resources, including UIO devices.

	  http://github.com/pedwo/libuiomux/
```

## target/device/Renesas/Config.in
```kconfig
menuconfig BR2_TARGET_RENESAS
	bool "Renesas Device Support"
	depends on BR2_sh || BR2_cortex_a8

if BR2_TARGET_RENESAS

config BR2_TARGET_MS7724
	bool "MS7724"
	depends on BR2_sh4
	help
	 MS7724 (Ecovec) Development board

config BR2_TARGET_AP325RXA
	bool "AP325RXA"
	depends on BR2_sh4
	help
	 Algo AP325RXA board

config BR2_TARGET_SH7785LCR
	bool "SH7785LCR"
	depends on BR2_sh4
	help
	 SH7785LCR board

config BR2_TARGET_AP4EVB
	bool "AP4EVB"
	depends on BR2_cortex_a8
	help
	 AP4 EVB Development board (ROP7372LC)

config BR2_BOARD_NAME
	string
	default "MS7724"		if BR2_TARGET_MS7724
	default "AP325RXA"		if BR2_TARGET_AP325RXA
	default "SH7785LCR"		if BR2_TARGET_SH7785LCR
	default "AP4EVB"		if BR2_TARGET_AP4EVB

config BR2_BOARD_PATH
	string "Board Path"
	default "target/device/Renesas/$(BR2_BOARD_NAME)"

endif
```
